/dts-v1/;
/plugin/;

/ {
	compatible = "phytium,pi";

	fragment@0 {
		target-path = "/";
		__overlay__ {
			#address-cells = <2>;
			#size-cells = <2>;

			gpioctl-raw-conflict-zsh@28038000 {
				compatible = "zsh,phytium-gpio-raw-lab";
				reg = <0x0 0x28038000 0x0 0x1000>;
				status = "okay";
			};
		};
	};
};
